## linux-4.4.10/security/myrbac/Kconfig
```kconfig
config SECURITY_MYRBAC
        bool "myrbac"
        depends on SECURITY
        default n
        help
          This option enables support for the My Security Module.
```
